## conf/distro/pixelatedrailroad.conf
```bitbake
include conf/distro/include/pixelated-common.inc

SDK_VENDOR = "-pxlrdrrsdk"

MAINTAINER = "ruaine83@gmail.com"

TARGET_VENDOR = "-pixelatedrailroad"

# EXTRA_IMAGE_FEATURES:remove = "debug-tweaks"

DISTRO_FEATURES:append = " systemd pam security integrity tpm tpm2 virtualization"
```
